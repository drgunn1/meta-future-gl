## conf/layer.conf
```bitbake
# We have a conf and classes directory, add to BBPATH
BBPATH .= ":${LAYERDIR}"

# We have recipes-* directories, add to BBFILES
BBFILES += "${LAYERDIR}/recipes-*/*/*.bb \
	${LAYERDIR}/recipes-*/*/*.bbappend"

BBFILE_COLLECTIONS += "meta-future-gl"
BBFILE_PATTERN_meta-future-gl= "^${LAYERDIR}/"
BBFILE_PRIORITY_meta-future-gl = "6"

LAYERSERIES_COMPAT_meta-future-gl = "kirkstone"
```

## conf/machine/imx8mp-future-gl.conf
```bitbake
#@TYPE: Machine
#@NAME: FutureGL board
#@SOC: i.MX8MP
#@DESCRIPTION: Machine configuration for FutureGL board
#@MAINTAINER: Don Gunn <don.gunn@futureelectronics.com>
require conf/machine/imx8mp-futuregl.inc

# The device tree name is implicit for LPDDR4, so can't use MACHINE here
KERNEL_DEVICETREE_BASENAME = "imx8mp-futuregl"

# NXP kernel has additional DTB files for various board configuration and
# derivates. Include them here for NXP BSP only

#Saving this for later if we end up having multiple device tree configurations for add on boards
#KERNEL_DEVICETREE:append:use-nxp-bsp = " \
#    freescale/imx8mp-evk-8mic-swpdm.dtb \
#"

UBOOT_CONFIG_BASENAME = "imx8mp_futuregl"
UBOOT_CONFIG[fspi] = "${UBOOT_CONFIG_BASENAME}_defconfig"
#UBOOT_CONFIG[ndm]  = "${UBOOT_CONFIG_BASENAME}_ndm_defconfig"

# Set DDR FIRMWARE
DDR_FIRMWARE_VERSION = "202006"
DDR_FIRMWARE_NAME = " \
    ddr4_dmem_1d_${DDR_FIRMWARE_VERSION}.bin \
    ddr4_imem_1d_${DDR_FIRMWARE_VERSION}.bin \
    ddr4_dmem_2d_${DDR_FIRMWARE_VERSION}.bin \
    ddr4_imem_2d_${DDR_FIRMWARE_VERSION}.bin \
"

IMXBOOT_TARGETS_BASENAME = "flash_ddr4_evk"

# Mainline BSP doesn't support DDR4 so it must be set to nxp.
# Also this machine isn't supported by u-boot-fslc but imx8mn-evk.inc already
# set the bootloader to u-boot-imx instead when NXP BSP is used.
IMX_DEFAULT_BSP = "nxp"
```
